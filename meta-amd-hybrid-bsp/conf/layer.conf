## meta-amd-hybrid-bsp/conf/layer.conf
```bitbake
# We have a conf and classes directory, add to BBPATH
BBPATH .= ":${LAYERDIR}"

# We have a packages directory, add to BBFILES
BBFILES += " \
    ${LAYERDIR}/recipes-*/*/*.bb \
    ${LAYERDIR}/recipes-*/*/*.bbappend \
    "

BBFILE_COLLECTIONS += "amd-hybrid-bsp"
BBFILE_PRIORITY_amd-hybrid-bsp = "5"

LAYERSUMMARY_amd-hybrid-bsp = "AMD hybrid platform board support and BSP"
LAYERDESCRIPTION_amd-hybrid-bsp = "BSP layer for AMD hybrid \
products: machine .conf, machine YAML, and supporting recipes for the \
Alveo V80 (AMR) and Embedded+ VE2302 (AMR) boards."
BBFILE_PATTERN_amd-hybrid-bsp = "^${LAYERDIR}/"
BBFILE_PATTERN_IGNORE_EMPTY_amd-hybrid-bsp = "1"

LAYERDEPENDS_amd-hybrid-bsp  = "core xilinx xilinx-standalone xilinx-standalone-sdt xilinx-microblaze amd-adaptive-socs-core amd-hybrid-core openembedded-layer meta-python"

LAYERRECOMMENDS_amd-hybrid-bsp = "xilinx-tools"

LAYERSERIES_COMPAT_amd-hybrid-bsp = "wrynose"

LAYER_PATH_amd-hybrid-bsp-layer = "${LAYERDIR}"
```

## meta-amd-hybrid-bsp/conf/machine/alveo-v95-amr.conf
```bitbake
#@TYPE: Machine
#@NAME: alveo-v95-amr
#@DESCRIPTION: AMP/multidomain machine for the AMD Alveo V80 Compute Accelerator Card (Versal Premium) running the AMR (AVED Management Runtime) stack: Cortex-A72 Linux plus Cortex-R5 FreeRTOS and MicroBlaze PMC/PSM sub-machines.

BBMULTICONFIG += "alveo-v95-amr-microblaze-pmc alveo-v95-amr-microblaze-psm"
MACHINEOVERRIDES .= ":amd-amr"

#### Preamble
MACHINEOVERRIDES =. "${@['', 'alveo-v95-amr:']['alveo-v95-amr' !='${MACHINE}']}"
#### Regular settings follow
TUNEFILE[microblaze-pmc] = "conf/machine/include/alveo-v95-amr/microblaze.inc"
TUNEFILE[microblaze-psm] = "conf/machine/include/alveo-v95-amr/microblaze.inc"

# Platform Loader and Manager
PLM_DEPENDS = ""
PLM_MCDEPENDS = "mc::alveo-v95-amr-microblaze-pmc:plm-firmware:do_deploy"
PLM_DEPLOY_DIR = "${TMPDIR}-alveo-v95-amr-microblaze-pmc/deploy/images/${MACHINE}"

# PSM Firmware
PSM_DEPENDS = ""
PSM_MCDEPENDS = "mc::alveo-v95-amr-microblaze-psm:psm-firmware:do_deploy"
PSM_FIRMWARE_DEPLOY_DIR = "${TMPDIR}-alveo-v95-amr-microblaze-psm/deploy/images/${MACHINE}"

# Set the default (linux) domain device tree
CONFIG_DTFILE_DIR := "${@bb.utils.which(d.getVar('BBPATH'), 'conf/dts/alveo-v95-amr')}"
CONFIG_DTFILE ?= "${CONFIG_DTFILE_DIR}/cortexa72-linux.dts"
CONFIG_DTFILE[vardepsexclude] += "CONFIG_DTFILE_DIR"

DTB_FILE_PATH ?= "${RECIPE_SYSROOT}/boot/devicetree/${@os.path.basename(d.getVar('CONFIG_DTFILE').replace('.dts', '.dtb'))}"

# Serial Console Settings
SERIAL_CONSOLES ?= "115200;ttyAMA1"

# Yocto arm-trusted-firmware(TF-A) variables
TFA_CONSOLE ?= "pl011_1"
TFA_BL33_LOAD ?= "0x8000000"

# Yocto u-boot-xlnx variables
UBOOT_USER_SPECIFIED_TEXT_BASE ?= "0x8000000"

# Set DDR Base address for u-boot-xlnx-scr variables
DDR_BASEADDR ?= "0x0"
SKIP_APPEND_BASEADDR ?= "0"

# Yocto KERNEL Variables
UBOOT_ENTRYPOINT ?= "0x200000"
UBOOT_LOADADDRESS ?= "0x200000"

# Yocto MACHINE_FEATURES Variable
MACHINE_FEATURES += "fpga-overlay efi"

# Required generic machine inclusion
require conf/machine/versal-2vp-generic.conf

# QEMU Memory Configuration
QB_MEM = "-machine dynamic-mem=on -device amd-ddr-memory,address=0x800000000,size=0x380000000"

# This is an 'SDT' based BSP
XILINX_WITH_ESW = "sdt"

# Original SDT artifacts URL
SDT_URI = "https://xcoartifactory.xilinx.com/artifactory/petalinux-hwproj-dev-local/edf_files/test_upload/v95_sdt.tar.gz"
SDT_URI[sha256sum] = "56d146edd35a7c1bdbfc0fe8b63f8fb14269424f006978d043106ffb25c3b447"

# Set the system device trees
SYSTEM_DTFILE_DEPENDS = "sdt-artifacts"
SYSTEM_DTFILE_DIR = "${RECIPE_SYSROOT}${datadir}/sdt/${MACHINE}"
SYSTEM_DTFILE = "${SYSTEM_DTFILE_DIR}/system-top.dts"

# Load the dynamic machine features
include conf/machine/include/alveo-v95-amr/${BB_CURRENT_MC}-features.conf
LIBXIL_CONFIG = "conf/machine/include/alveo-v95-amr/${BB_CURRENT_MC}-libxil.conf"

# PDI variables
PDI_PATH_DEPENDS = "sdt-artifacts"
PDI_PATH_DIR = "${RECIPE_SYSROOT}${datadir}/sdt/${MACHINE}"
PDI_PATH = "${PDI_PATH_DIR}/v95_ps_noc_boot.pdi"

# Primary Bootmode value
DEFAULT_HW_BOOT_MODE = "8"

# Update bootbin to use proper device tree
BIF_PARTITION_IMAGE[device-tree] = "${DTB_FILE_PATH}"

# Remap boot files to ensure the right device tree is listed first
IMAGE_BOOT_FILES =+ "devicetree/${@os.path.basename(d.getVar('CONFIG_DTFILE').replace('.dts', '.dtb'))}"

#### No additional settings should be after the Postamble
#### Postamble
PACKAGE_EXTRA_ARCHS:append = "${@['', ' alveo_v95_amr']['alveo-v95-amr' != '${MACHINE}']}"
```

## meta-amd-hybrid-bsp/conf/machine/include/versal2-2ve-2vm-ve3558-sdt-seg/microblaze-v.inc
```bitbake
require conf/machine/include/xilinx-microblaze-v.inc

# compatible = "xlnx,microblaze_v";
TUNE_FEATURES:tune-microblaze-v = "${@oe.tune.riscv_isa_to_tune("rv32imac_zicsr_zifencei")}"

# compatible = "xlnx,microblaze_v_asu";
AVAILTUNES += "microblaze-v-asu"
TUNE_FEATURES:tune-microblaze-v-asu = "${@oe.tune.riscv_isa_to_tune("rv32imac_zicsr_zifencei")}"
PACKAGE_EXTRA_ARCHS:tune-microblaze-v-asu = "${TUNE_RISCV_PKGARCH}"
```

## meta-amd-hybrid-bsp/conf/machine/include/versal2-2ve-2vm-ve3558-sdt-seg/versal2-2ve-2vm-ve3558-sdt-seg-microblaze-pmc-features.conf
```bitbake
MACHINE_FEATURES = "cframe cfupmc common csudma emacps gpiops iicps iomodule ipipsu ospipsv spips sysmonpsv trngpsx ttcps uartpsv ufspsxc zdma"
```

## meta-amd-hybrid-bsp/conf/machine/include/versal2-2ve-2vm-ve3558-sdt-seg/versal2-2ve-2vm-ve3558-sdt-seg-microblaze-riscv-asu-features.conf
```bitbake
MACHINE_FEATURES = "asu-ram-ecc common csudma dcsub emacps gpiops iicps iomodule ipipsu mmidp rtcpsu spips uartpsv usbpsu video-common"
```

## meta-amd-hybrid-bsp/conf/machine/versal2-2ve-2vm-ve3558-sdt-seg.conf
```bitbake
#@TYPE: Machine
#@NAME: versal2-2ve-2vm-ve3558-sdt-seg
#@DESCRIPTION: Segmented SDT machine for the AMD Versal Gen 2 VE3558 evaluation kit: Cortex-A78 Linux plus MicroBlaze PMC firmware sub-machine.

BBMULTICONFIG += "versal2-2ve-2vm-ve3558-sdt-seg-microblaze-pmc versal2-2ve-2vm-ve3558-sdt-seg-microblaze-riscv-asu"

#### Preamble
MACHINEOVERRIDES =. "${@['', 'versal2-2ve-2vm-ve3558-sdt-seg:']['versal2-2ve-2vm-ve3558-sdt-seg' !='${MACHINE}']}"
#### Regular settings follow
TUNEFILE[microblaze-pmc] = "conf/machine/include/versal2-2ve-2vm-ve3558-sdt-seg/microblaze.inc"
TUNEFILE[microblaze-v-asu] = "conf/machine/include/versal2-2ve-2vm-ve3558-sdt-seg/microblaze-v.inc"

# Platform Loader and Manager
PLM_DEPENDS = ""
PLM_MCDEPENDS = "mc::versal2-2ve-2vm-ve3558-sdt-seg-microblaze-pmc:plm-firmware:do_deploy"
PLM_DEPLOY_DIR = "${TMPDIR}-versal2-2ve-2vm-ve3558-sdt-seg-microblaze-pmc/deploy/images/${MACHINE}"

# ASU Firmware
ASU_DEPENDS = ""
ASU_MCDEPENDS = "mc::versal2-2ve-2vm-ve3558-sdt-seg-microblaze-riscv-asu:asu-firmware:do_deploy"
ASU_DEPLOY_DIR = "${TMPDIR}-versal2-2ve-2vm-ve3558-sdt-seg-microblaze-riscv-asu/deploy/images/${MACHINE}"

# Set the default (linux) domain device tree
CONFIG_DTFILE_DIR := "${@bb.utils.which(d.getVar('BBPATH'), 'conf/dts/versal2-2ve-2vm-ve3558-sdt-seg')}"
CONFIG_DTFILE ?= "${CONFIG_DTFILE_DIR}/cortexa78-linux.dts"
CONFIG_DTFILE[vardepsexclude] += "CONFIG_DTFILE_DIR"

DTB_FILE_PATH ?= "${RECIPE_SYSROOT}/boot/devicetree/${@os.path.basename(d.getVar('CONFIG_DTFILE').replace('.dts', '.dtb'))}"

# Serial Console Settings
SERIAL_CONSOLES ?= "115200;ttyAMA0"

# Yocto arm-trusted-firmware(TF-A) variables
TFA_CONSOLE ?= "pl011"
TFA_BL33_LOAD ?= "0x40000000"

# Yocto OP-TEE variables
OPTEE_CONSOLE ?= "0"

# Yocto u-boot-xlnx variables
UBOOT_USER_SPECIFIED_TEXT_BASE ?= "0x40000000"

# Set DDR Base address for u-boot-xlnx-scr variables
DDR_BASEADDR ?= "0x0"
SKIP_APPEND_BASEADDR ?= "0"

# Yocto KERNEL Variables
UBOOT_ENTRYPOINT ?= "0x200000"
UBOOT_LOADADDRESS ?= "0x200000"

# Yocto MACHINE_FEATURES Variable
MACHINE_FEATURES += "vcu2 malig78ae asu fpga-overlay efi"

# Required generic machine inclusion
require conf/machine/versal-2ve-2vm-generic.conf

# QEMU Memory Configuration
QB_MEM = "-machine dynamic-mem=on -device amd-ddr-memory,address=0x800000000,size=0x380000000"

# This is an 'SDT' based BSP
XILINX_WITH_ESW = "sdt"

# Original SDT artifacts URL
SDT_URI = "https://edf.amd.com/sswreleases/rel-v2026.2/sdt/2026.2/2026.2_0920_1_09200102/internal/versal2-2ve-2vm-ve3558-sdt-seg/versal2-2ve-2vm-ve3558-sdt-seg_2026.2_0920_1_09200102.tar.gz"
SDT_URI[sha256sum] = "480b7acc24e79af5f96532e37009d444d7a0b0532e0b42f448d28edcb830ad59"
SDT_URI[S] = "${UNPACKDIR}/versal2-2ve-2vm-ve3558-sdt-seg_2026.2_0920_1_09200102"

# Set the system device trees
SYSTEM_DTFILE_DEPENDS = "sdt-artifacts"
SYSTEM_DTFILE_DIR = "${RECIPE_SYSROOT}${datadir}/sdt/${MACHINE}"
SYSTEM_DTFILE = "${SYSTEM_DTFILE_DIR}/system-top.dts"

# Load the dynamic machine features
include conf/machine/include/versal2-2ve-2vm-ve3558-sdt-seg/${BB_CURRENT_MC}-features.conf
LIBXIL_CONFIG = "conf/machine/include/versal2-2ve-2vm-ve3558-sdt-seg/${BB_CURRENT_MC}-libxil.conf"

# PDI variables
PDI_PATH_DEPENDS = "sdt-artifacts"
PDI_PATH_DIR = "${RECIPE_SYSROOT}${datadir}/sdt/${MACHINE}"
PDI_PATH = "${PDI_PATH_DIR}/rave2_base_boot.pdi"

# Primary Bootmode value
DEFAULT_HW_BOOT_MODE = "8"

# Update bootbin to use proper device tree
BIF_PARTITION_IMAGE[device-tree] = "${DTB_FILE_PATH}"

# Remap boot files to ensure the right device tree is listed first
IMAGE_BOOT_FILES =+ "devicetree/${@os.path.basename(d.getVar('CONFIG_DTFILE').replace('.dts', '.dtb'))}"

#### No additional settings should be after the Postamble
#### Postamble
PACKAGE_EXTRA_ARCHS:append = "${@['', ' versal2_2ve_2vm_ve3558_sdt_seg']['versal2-2ve-2vm-ve3558-sdt-seg' != '${MACHINE}']}"
```

## meta-amd-hybrid-core/conf/layer.conf
```bitbake
# We have a conf and classes directory, add to BBPATH
BBPATH .= ":${LAYERDIR}"

# We have a packages directory, add to BBFILES
BBFILES += " \
    ${LAYERDIR}/recipes-*/*/*.bb \
    ${LAYERDIR}/recipes-*/*/*.bbappend \
    "

BBFILE_COLLECTIONS += "amd-hybrid-core"
BBFILE_PRIORITY_amd-hybrid-core = "5"

LAYERSUMMARY_amd-hybrid-core = "AMD hybrid platform core infra and recipes"
LAYERDESCRIPTION_amd-hybrid-core = "Shared non-BSP layer for AMD hybrid \
products: image, kernel and library recipes and \
bbappends shared across the Alveo V80 (AMR) and Embedded+ VE2302 (AMR) \
boards."
BBFILE_PATTERN_amd-hybrid-core = "^${LAYERDIR}/"
BBFILE_PATTERN_IGNORE_EMPTY_amd-hybrid-core = "1"

LAYERDEPENDS_amd-hybrid-core = "\
    core \
    xilinx \
    xilinx-standalone \
    xilinx-standalone-sdt \
    xilinx-microblaze \
    amd-adaptive-socs-core \
    openembedded-layer \
    networking-layer \
    "

LAYERSERIES_COMPAT_amd-hybrid-core = "wrynose"
```

## meta-embedded-plus-bsp/conf/layer.conf
```bitbake
# We have a conf and classes directory, add to BBPATH
BBPATH .= ":${LAYERDIR}"

# We have a packages directory, add to BBFILES
BBFILES += " \
    ${LAYERDIR}/recipes-*/*/*.bb \
    ${LAYERDIR}/recipes-*/*/*.bbappend \
    "

BBFILE_COLLECTIONS += "embedded-plus-bsp"
BBFILE_PRIORITY_embedded-plus-bsp = "5"

LAYERSUMMARY_embedded-plus-bsp = "AMD Embedded+ board support and BSP"
LAYERDESCRIPTION_embedded-plus-bsp = "BSP layer for AMD Embedded+ \
products: machine .conf, machine YAML, and supporting recipes for the \
Alveo V80 (AMR) and Embedded+ VE2302 (AMR) boards."
BBFILE_PATTERN_embedded-plus-bsp = "^${LAYERDIR}/"
BBFILE_PATTERN_IGNORE_EMPTY_embedded-plus-bsp = "1"

LAYERDEPENDS_embedded-plus-bsp  = "core xilinx xilinx-standalone xilinx-standalone-sdt xilinx-microblaze amd-adaptive-socs-core embedded-plus-core openembedded-layer meta-python"

LAYERRECOMMENDS_embedded-plus-bsp = "xilinx-tools"

LAYERSERIES_COMPAT_embedded-plus-bsp = "wrynose"

LAYER_PATH_embedded-plus-bsp-layer = "${LAYERDIR}"
```

## meta-embedded-plus-core/conf/layer.conf
```bitbake
# We have a conf and classes directory, add to BBPATH
BBPATH .= ":${LAYERDIR}"

# We have a packages directory, add to BBFILES
BBFILES += " \
    ${LAYERDIR}/recipes-*/*/*.bb \
    ${LAYERDIR}/recipes-*/*/*.bbappend \
    "

BBFILE_COLLECTIONS += "embedded-plus-core"
BBFILE_PRIORITY_embedded-plus-core = "5"

LAYERSUMMARY_embedded-plus-core = "AMD Embedded+ core infra and recipes"
LAYERDESCRIPTION_embedded-plus-core = "Shared non-BSP layer for AMD \
Embedded+ products: image, kernel, library and utility recipes and \
bbappends shared across the Alveo V80 (AMR) and Embedded+ VE2302 (AMR / \
XRT) boards."
BBFILE_PATTERN_embedded-plus-core = "^${LAYERDIR}/"
BBFILE_PATTERN_IGNORE_EMPTY_embedded-plus-core = "1"

LAYERDEPENDS_embedded-plus-core = "core xilinx xilinx-standalone xilinx-standalone-sdt xilinx-microblaze amd-adaptive-socs-core openembedded-layer networking-layer"

LAYERSERIES_COMPAT_embedded-plus-core = "wrynose"
```
